/dts-v1/;

/ {

	__fixups__ {
		accdet = "/fragment@9:target:0";
		auxadc = "/fragment@32:target:0", "/fragment@33/__overlay__:io-channels:0";
		chosen = "/fragment@3:target:0";
		dispsys_config = "/fragment@8:target:0";
		dsi0 = "/fragment@21:target:0";
		dsi_te = "/fragment@53:target:0";
		goodix_fp = "/fragment@13:target:0";
		gpio = "/fragment@46:target:0";
		gpio_usage_mapping = "/fragment@45:target:0";
		gps = "/fragment@20:target:0";
		i2c0 = "/fragment@23:target:0", "/fragment@35:target:0";
		i2c1 = "/fragment@36:target:0";
		i2c2 = "/fragment@28:target:0", "/fragment@37:target:0";
		i2c3 = "/fragment@38:target:0";
		i2c4 = "/fragment@29:target:0", "/fragment@39:target:0";
		i2c5 = "/fragment@40:target:0";
		i2c6 = "/fragment@41:target:0";
		i2c7 = "/fragment@42:target:0";
		i2c8 = "/fragment@30:target:0", "/fragment@43:target:0";
		i2c9 = "/fragment@31:target:0", "/fragment@44:target:0";
		irq_nfc = "/fragment@48:target:0";
		irtx_pwm = "/fragment@10:target:0";
		kd_camera_hw1 = "/fragment@22:target:0", "/fragment@27:target:0", "/fragment@58:target:0";
		keypad = "/fragment@60:target:0";
		md1_sim1_hot_plug_eint = "/fragment@55:target:0";
		md_auxadc = "/fragment@33:target:0";
		mmc0 = "/fragment@4:target:0";
		mmc_fixed_1v8_io = "/fragment@1:target:0", "/fragment@4/__overlay__:vqmmc-supply:0";
		mmc_fixed_3v3 = "/fragment@0:target:0", "/fragment@4/__overlay__:vmmc-supply:0";
		mrdump_ext_rst = "/fragment@47:target:0";
		mt6360_pmic = "/fragment@16:target:0";
		mt6360_pmu = "/fragment@15:target:0";
		mt6360_typec = "/fragment@17:target:0";
		mt_pmic_vcamio_ldo_reg = "/fragment@27/__overlay__:cam0_vcamio-supply:0", "/fragment@27/__overlay__:cam1_vcamio-supply:0", "/fragment@27/__overlay__:cam2_vcamio-supply:0", "/fragment@27/__overlay__:cam4_vcamio-supply:0", "/fragment@56:target:0", "/fragment@58/__overlay__:vcamio-supply:0", "/fragment@58/__overlay__:vcamio_sub-supply:0", "/fragment@58/__overlay__:vcamio_main2-supply:0", "/fragment@58/__overlay__:vcamaf-supply:0", "/fragment@58/__overlay__:vcamaf_main2-supply:0";
		mt_pmic_vfp_ldo_reg = "/fragment@12/__overlay__/fingerprint@0:vfp-supply:0";
		mt_pmic_vmc_ldo_reg = "/fragment@21/__overlay__/panel1@0:ldo3-supply:0";
		mt_pmic_vtp_ldo_reg = "/fragment@23/__overlay__/gt9886@5d:vtouch-supply:0", "/fragment@24/__overlay__/gt9896s@0:vtouch-supply:0", "/fragment@57:target:0", "/fragment@59/__overlay__:vtouch-supply:0";
		mtkfb = "/fragment@7:target:0";
		odm = "/fragment@5:target:0";
		pio = "/fragment@6:target:0", "/fragment@11:target:0", "/fragment@13/__overlay__:interrupt-parent:0", "/fragment@14:target:0", "/fragment@15/__overlay__:mt6360,intr_gpio:0", "/fragment@17/__overlay__:mt6360pd,intr_gpio:0", "/fragment@18:target:0", "/fragment@19:target:0", "/fragment@21/__overlay__/panel1@0:pm-enable-gpios:0", "/fragment@21/__overlay__/panel1@0:reset-gpios:0", "/fragment@21/__overlay__/panel1@0:bias-gpios:0", "/fragment@23/__overlay__/gt9886@5d:interrupt-parent:0", "/fragment@23/__overlay__/gt9886@5d:goodix,reset-gpio:0", "/fragment@23/__overlay__/gt9886@5d:goodix,irq-gpio:0", "/fragment@24/__overlay__/gt9896s@0:goodix,reset-gpio:0", "/fragment@24/__overlay__/gt9896s@0:goodix,irq-gpio:0", "/fragment@25:target:0", "/fragment@26:target:0", "/fragment@45/__overlay__:GPIO_SIM1_HOT_PLUG:0", "/fragment@45/__overlay__:GPIO_SIM2_SCLK:0", "/fragment@45/__overlay__:GPIO_SIM2_SRST:0", "/fragment@45/__overlay__:GPIO_SIM2_SIO:0", "/fragment@45/__overlay__:GPIO_SIM1_SIO:0", "/fragment@45/__overlay__:GPIO_SIM1_SRST:0", "/fragment@45/__overlay__:GPIO_SIM1_SCLK:0", "/fragment@45/__overlay__:GPIO_FDD_BAND_SUPPORT_DETECT_1ST_PIN:0", "/fragment@45/__overlay__:GPIO_FDD_BAND_SUPPORT_DETECT_2ND_PIN:0", "/fragment@45/__overlay__:GPIO_FDD_BAND_SUPPORT_DETECT_3RD_PIN:0", "/fragment@45/__overlay__:GPIO_FDD_BAND_SUPPORT_DETECT_4TH_PIN:0", "/fragment@47/__overlay__:interrupt-parent:0", "/fragment@47/__overlay__:deb-gpios:0", "/fragment@48/__overlay__:interrupt-parent:0", "/fragment@49/__overlay__:interrupt-parent:0", "/fragment@50/__overlay__:interrupt-parent:0", "/fragment@51/__overlay__:interrupt-parent:0", "/fragment@52/__overlay__:interrupt-parent:0", "/fragment@53/__overlay__:interrupt-parent:0", "/fragment@54/__overlay__:interrupt-parent:0", "/fragment@54/__overlay__:deb-gpios:0";
		pmic_clock_buffer_ctrl = "/fragment@34:target:0";
		reserved_memory = "/fragment@2:target:0";
		smart_pa = "/fragment@52:target:0";
		spi1 = "/fragment@12:target:0";
		spi4 = "/fragment@24:target:0";
		subpmic_pmu_eint = "/fragment@50:target:0";
		swtp = "/fragment@54:target:0";
		tcpc_pd = "/fragment@51:target:0";
		touch = "/fragment@49:target:0", "/fragment@59:target:0";
	};

	__local_fixups__ {

		fragment@10 {

			__overlay__ {
				pinctrl-0 = <0x0>;
				pinctrl-1 = <0x0>;
			};
		};

		fragment@13 {

			__overlay__ {
				pinctrl-0 = <0x0>;
				pinctrl-1 = <0x0>;
				pinctrl-2 = <0x0>;
				pinctrl-3 = <0x0>;
			};
		};

		fragment@20 {

			__overlay__ {
				pinctrl-0 = <0x0>;
				pinctrl-1 = <0x0>;
				pinctrl-2 = <0x0>;
				pinctrl-3 = <0x0>;
				pinctrl-4 = <0x0>;
				pinctrl-5 = <0x0>;
				pinctrl-6 = <0x0>;
			};
		};

		fragment@21 {

			__overlay__ {

				panel1@0 {

					port {

						endpoint {
							remote-endpoint = <0x0>;
						};
					};
				};

				ports {

					port {

						endpoint {
							remote-endpoint = <0x0>;
						};
					};
				};
			};
		};

		fragment@23 {

			__overlay__ {
				pinctrl-0 = <0x0>;
				pinctrl-1 = <0x0>;
				pinctrl-2 = <0x0>;
				pinctrl-3 = <0x0>;
				pinctrl-4 = <0x0>;
				pinctrl-5 = <0x0>;
			};
		};

		fragment@24 {

			__overlay__ {
				pinctrl-0 = <0x0>;
				pinctrl-1 = <0x0>;
				pinctrl-2 = <0x0>;
				pinctrl-3 = <0x0>;
				pinctrl-4 = <0x0>;
				pinctrl-5 = <0x0>;
			};
		};

		fragment@27 {

			__overlay__ {
				pinctrl-0 = <0x0>;
				pinctrl-1 = <0x0>;
				pinctrl-10 = <0x0>;
				pinctrl-11 = <0x0>;
				pinctrl-12 = <0x0>;
				pinctrl-13 = <0x0>;
				pinctrl-14 = <0x0>;
				pinctrl-15 = <0x0>;
				pinctrl-16 = <0x0>;
				pinctrl-17 = <0x0>;
				pinctrl-18 = <0x0>;
				pinctrl-19 = <0x0>;
				pinctrl-2 = <0x0>;
				pinctrl-20 = <0x0>;
				pinctrl-21 = <0x0>;
				pinctrl-22 = <0x0>;
				pinctrl-23 = <0x0>;
				pinctrl-24 = <0x0>;
				pinctrl-25 = <0x0>;
				pinctrl-26 = <0x0>;
				pinctrl-27 = <0x0>;
				pinctrl-28 = <0x0>;
				pinctrl-29 = <0x0>;
				pinctrl-3 = <0x0>;
				pinctrl-30 = <0x0>;
				pinctrl-31 = <0x0>;
				pinctrl-32 = <0x0>;
				pinctrl-33 = <0x0>;
				pinctrl-34 = <0x0>;
				pinctrl-35 = <0x0>;
				pinctrl-36 = <0x0>;
				pinctrl-37 = <0x0>;
				pinctrl-38 = <0x0>;
				pinctrl-39 = <0x0>;
				pinctrl-4 = <0x0>;
				pinctrl-40 = <0x0>;
				pinctrl-41 = <0x0>;
				pinctrl-42 = <0x0>;
				pinctrl-43 = <0x0>;
				pinctrl-44 = <0x0>;
				pinctrl-45 = <0x0>;
				pinctrl-46 = <0x0>;
				pinctrl-47 = <0x0>;
				pinctrl-48 = <0x0>;
				pinctrl-49 = <0x0>;
				pinctrl-5 = <0x0>;
				pinctrl-50 = <0x0>;
				pinctrl-51 = <0x0>;
				pinctrl-52 = <0x0>;
				pinctrl-6 = <0x0>;
				pinctrl-7 = <0x0>;
				pinctrl-8 = <0x0>;
				pinctrl-9 = <0x0>;
			};
		};

		fragment@5 {

			__overlay__ {

				usb_c_pinctrl {
					pinctrl-0 = <0x0>;
					pinctrl-1 = <0x0>;
					pinctrl-10 = <0x0>;
					pinctrl-11 = <0x0>;
					pinctrl-12 = <0x0>;
					pinctrl-2 = <0x0>;
					pinctrl-3 = <0x0>;
					pinctrl-4 = <0x0>;
					pinctrl-5 = <0x0>;
					pinctrl-6 = <0x0>;
					pinctrl-7 = <0x0>;
					pinctrl-8 = <0x0>;
					pinctrl-9 = <0x0>;
				};
			};
		};

		fragment@7 {

			__overlay__ {
				pinctrl-0 = <0x0>;
				pinctrl-1 = <0x0>;
				pinctrl-2 = <0x0>;
				pinctrl-3 = <0x0>;
				pinctrl-4 = <0x0>;
				pinctrl-5 = <0x0>;
				pinctrl-6 = <0x0>;
			};
		};

		fragment@8 {

			__overlay__ {
				pinctrl-0 = <0x0>;
				pinctrl-1 = <0x0>;
				pinctrl-2 = <0x0>;
			};
		};
	};

	__symbols__ {
		camera_main_af_mtk = "/fragment@37/__overlay__/camera_main_af@19";
		camera_main_eeprom_mtk = "/fragment@37/__overlay__/camera_main_eeprom@a1";
		camera_main_mtk = "/fragment@37/__overlay__/camera_main@21";
		camera_main_three_eeprom_mtk = "/fragment@44/__overlay__/camera_main_three_eeprom@51";
		camera_main_three_mtk = "/fragment@44/__overlay__/camera_main_three@10";
		camera_main_two_eeprom_mtk = "/fragment@39/__overlay__/camera_main_two_eeprom@a3";
		camera_main_two_mtk = "/fragment@39/__overlay__/camera_main_two@45";
		camera_pins_cam0_mclk_2ma = "/fragment@26/__overlay__/camera_pins_cam0_mclk_2ma";
		camera_pins_cam0_mclk_4ma = "/fragment@26/__overlay__/camera_pins_cam0_mclk_4ma";
		camera_pins_cam0_mclk_6ma = "/fragment@26/__overlay__/camera_pins_cam0_mclk_6ma";
		camera_pins_cam0_mclk_8ma = "/fragment@26/__overlay__/camera_pins_cam0_mclk_8ma";
		camera_pins_cam0_mclk_off = "/fragment@26/__overlay__/camera_pins_cam0_mclk_off";
		camera_pins_cam0_pnd_0 = "/fragment@26/__overlay__/cam0@2";
		camera_pins_cam0_pnd_1 = "/fragment@26/__overlay__/cam0@3";
		camera_pins_cam0_rst_0 = "/fragment@26/__overlay__/cam0@0";
		camera_pins_cam0_rst_1 = "/fragment@26/__overlay__/cam0@1";
		camera_pins_cam0_vcama_0 = "/fragment@26/__overlay__/cam0@vcam2";
		camera_pins_cam0_vcama_1 = "/fragment@26/__overlay__/cam0@vcam3";
		camera_pins_cam0_vcamd_0 = "/fragment@26/__overlay__/cam0@vcam0";
		camera_pins_cam0_vcamd_1 = "/fragment@26/__overlay__/cam0@vcam1";
		camera_pins_cam1_mclk_2ma = "/fragment@26/__overlay__/camera_pins_cam1_mclk_2ma";
		camera_pins_cam1_mclk_4ma = "/fragment@26/__overlay__/camera_pins_cam1_mclk_4ma";
		camera_pins_cam1_mclk_6ma = "/fragment@26/__overlay__/camera_pins_cam1_mclk_6ma";
		camera_pins_cam1_mclk_8ma = "/fragment@26/__overlay__/camera_pins_cam1_mclk_8ma";
		camera_pins_cam1_mclk_off = "/fragment@26/__overlay__/camera_pins_cam1_mclk_off";
		camera_pins_cam1_pnd_0 = "/fragment@26/__overlay__/cam1@2";
		camera_pins_cam1_pnd_1 = "/fragment@26/__overlay__/cam1@3";
		camera_pins_cam1_rst_0 = "/fragment@26/__overlay__/cam1@0";
		camera_pins_cam1_rst_1 = "/fragment@26/__overlay__/cam1@1";
		camera_pins_cam1_vcama_0 = "/fragment@26/__overlay__/cam1@vcam2";
		camera_pins_cam1_vcama_1 = "/fragment@26/__overlay__/cam1@vcam3";
		camera_pins_cam1_vcamd_0 = "/fragment@26/__overlay__/cam1@vcam0";
		camera_pins_cam1_vcamd_1 = "/fragment@26/__overlay__/cam1@vcam1";
		camera_pins_cam2_mclk_2ma = "/fragment@26/__overlay__/camera_pins_cam2_mclk_2ma";
		camera_pins_cam2_mclk_4ma = "/fragment@26/__overlay__/camera_pins_cam2_mclk_4ma";
		camera_pins_cam2_mclk_6ma = "/fragment@26/__overlay__/camera_pins_cam2_mclk_6ma";
		camera_pins_cam2_mclk_8ma = "/fragment@26/__overlay__/camera_pins_cam2_mclk_8ma";
		camera_pins_cam2_mclk_off = "/fragment@26/__overlay__/camera_pins_cam2_mclk_off";
		camera_pins_cam2_pnd_0 = "/fragment@26/__overlay__/cam2@2";
		camera_pins_cam2_pnd_1 = "/fragment@26/__overlay__/cam2@3";
		camera_pins_cam2_rst_0 = "/fragment@26/__overlay__/cam2@0";
		camera_pins_cam2_rst_1 = "/fragment@26/__overlay__/cam2@1";
		camera_pins_cam2_vcama_0 = "/fragment@26/__overlay__/cam2@vcam2";
		camera_pins_cam2_vcama_1 = "/fragment@26/__overlay__/cam2@vcam3";
		camera_pins_cam2_vcamd_0 = "/fragment@26/__overlay__/cam2@vcam0";
		camera_pins_cam2_vcamd_1 = "/fragment@26/__overlay__/cam2@vcam1";
		camera_pins_cam4_mclk_2ma = "/fragment@26/__overlay__/camera_pins_cam4_mclk_2ma";
		camera_pins_cam4_mclk_4ma = "/fragment@26/__overlay__/camera_pins_cam4_mclk_4ma";
		camera_pins_cam4_mclk_6ma = "/fragment@26/__overlay__/camera_pins_cam4_mclk_6ma";
		camera_pins_cam4_mclk_8ma = "/fragment@26/__overlay__/camera_pins_cam4_mclk_8ma";
		camera_pins_cam4_mclk_off = "/fragment@26/__overlay__/camera_pins_cam4_mclk_off";
		camera_pins_cam4_pnd_0 = "/fragment@26/__overlay__/cam4@2";
		camera_pins_cam4_pnd_1 = "/fragment@26/__overlay__/cam4@3";
		camera_pins_cam4_rst_0 = "/fragment@26/__overlay__/cam4@0";
		camera_pins_cam4_rst_1 = "/fragment@26/__overlay__/cam4@1";
		camera_pins_cam4_vcama_0 = "/fragment@26/__overlay__/cam4@vcam2";
		camera_pins_cam4_vcama_1 = "/fragment@26/__overlay__/cam4@vcam3";
		camera_pins_cam4_vcamd_0 = "/fragment@26/__overlay__/cam4@vcam0";
		camera_pins_cam4_vcamd_1 = "/fragment@26/__overlay__/cam4@vcam1";
		camera_pins_default = "/fragment@26/__overlay__/camdefault";
		camera_sub_eeprom_mtk = "/fragment@39/__overlay__/camera_sub_eeprom@a9";
		camera_sub_mtk = "/fragment@39/__overlay__/camera_sub@21";
		camera_sub_two_eeprom_mtk = "/fragment@37/__overlay__/camera_sub_two_eeprom@a5";
		camera_sub_two_mtk = "/fragment@37/__overlay__/camera_sub_two@7b";
		ctp_gt9896s_int_active = "/fragment@25/__overlay__/int1_active";
		ctp_gt9896s_int_suspend = "/fragment@25/__overlay__/int1_suspend";
		ctp_gt9896s_pins_default = "/fragment@25/__overlay__/pins_default";
		ctp_gt9896s_reset_active = "/fragment@25/__overlay__/reset1_active";
		ctp_gt9896s_reset_suspend = "/fragment@25/__overlay__/reset1_suspend";
		ctp_gt9896s_spi_mode = "/fragment@25/__overlay__/spimode_default";
		ctp_pins_default = "/fragment@25/__overlay__/eintdefault";
		ctp_ts_i2c_mode = "/fragment@25/__overlay__/i2cmode_default";
		ctp_ts_int_active = "/fragment@25/__overlay__/int_active";
		ctp_ts_int_as_gpio = "/fragment@25/__overlay__/int_high";
		ctp_ts_int_suspend = "/fragment@25/__overlay__/int_suspend";
		ctp_ts_reset_active = "/fragment@25/__overlay__/reset_active";
		ctp_ts_reset_suspend = "/fragment@25/__overlay__/reset_suspend";
		dp_switch_mtk = "/fragment@41/__overlay__/dp_switch@50";
		dsi_out = "/fragment@21/__overlay__/ports/port/endpoint";
		ext_buck_vmddr_mtk = "/fragment@41/__overlay__/ext_buck_vmddr@61";
		fan53870_mtk = "/fragment@43/__overlay__/fan53870@6b";
		fingerprint_default = "/fragment@14/__overlay__/state_default";
		fingerprint_eint_init = "/fragment@14/__overlay__/state_eint_init";
		fingerprint_reset_high = "/fragment@14/__overlay__/state_reset_high";
		fingerprint_reset_low = "/fragment@14/__overlay__/state_reset_low";
		gpio_redriver_c1_high = "/fragment@18/__overlay__/c1_high";
		gpio_redriver_c1_hiz = "/fragment@18/__overlay__/c1_highz";
		gpio_redriver_c1_init = "/fragment@18/__overlay__/c1_init";
		gpio_redriver_c1_low = "/fragment@18/__overlay__/c1_low";
		gpio_redriver_c2_high = "/fragment@18/__overlay__/c2_high";
		gpio_redriver_c2_hiz = "/fragment@18/__overlay__/c2_highz";
		gpio_redriver_c2_init = "/fragment@18/__overlay__/c2_init";
		gpio_redriver_c2_low = "/fragment@18/__overlay__/c2_low";
		gpio_u3_switch_disable = "/fragment@18/__overlay__/u3_sw_dis";
		gpio_u3_switch_enable = "/fragment@18/__overlay__/u3_sw_en";
		gpio_u3_switch_sel1 = "/fragment@18/__overlay__/u3_sw_sel1";
		gpio_u3_switch_sel2 = "/fragment@18/__overlay__/u3_sw_sel2";
		gps_l1_lna_pins_dsp_ctrl = "/fragment@19/__overlay__/gps_l1_lna@1";
		gps_l1_lna_pins_oh = "/fragment@19/__overlay__/gps_l1_lna@2";
		gps_l1_lna_pins_ol = "/fragment@19/__overlay__/gps_l1_lna@0";
		gps_l5_lna_pins_dsp_ctrl = "/fragment@19/__overlay__/gps_l5_lna@1";
		gps_l5_lna_pins_oh = "/fragment@19/__overlay__/gps_l5_lna@2";
		gps_l5_lna_pins_ol = "/fragment@19/__overlay__/gps_l5_lna@0";
		gps_pins_default = "/fragment@19/__overlay__/gps_default";
		i2c_lcd_bias_mtk = "/fragment@41/__overlay__/i2c_lcd_bias@3e";
		irtx_gpio_led_default = "/fragment@11/__overlay__/irtx_gpio_led_def@gpio127";
		irtx_gpio_led_set = "/fragment@11/__overlay__/irtx_gpio_led_set@gpio127";
		led0 = "/fragment@5/__overlay__/led@0";
		led1 = "/fragment@5/__overlay__/led@1";
		led2 = "/fragment@5/__overlay__/led@2";
		led3 = "/fragment@5/__overlay__/led@3";
		led4 = "/fragment@5/__overlay__/led@4";
		led5 = "/fragment@5/__overlay__/led@5";
		led6 = "/fragment@5/__overlay__/led@6";
		mtk_camera_eeprom0 = "/fragment@30/__overlay__/camera_eeprom0@50";
		mtk_camera_eeprom1 = "/fragment@29/__overlay__/camera_eeprom1@51";
		mtk_camera_eeprom2 = "/fragment@28/__overlay__/camera_eeprom2@50";
		mtk_camera_eeprom4 = "/fragment@31/__overlay__/camera_eeprom4@51";
		mtkfb_pins_lcd_bias_enn0 = "/fragment@6/__overlay__/lcd_bias_enn0_gpio";
		mtkfb_pins_lcd_bias_enn1 = "/fragment@6/__overlay__/lcd_bias_enn1_gpio";
		mtkfb_pins_lcd_bias_enp0 = "/fragment@6/__overlay__/lcd_bias_enp0_gpio";
		mtkfb_pins_lcd_bias_enp1 = "/fragment@6/__overlay__/lcd_bias_enp1_gpio";
		mtkfb_pins_lcm_dsi_te = "/fragment@6/__overlay__/lcm_dsi_te";
		mtkfb_pins_lcm_rst_out0_gpio = "/fragment@6/__overlay__/lcm_rst_out0_gpio";
		mtkfb_pins_lcm_rst_out1_gpio = "/fragment@6/__overlay__/lcm_rst_out1_gpio";
		nfc_mtk = "/fragment@38/__overlay__/nfc@08";
		panel_in = "/fragment@21/__overlay__/panel1@0/port/endpoint";
		subpmic_ldo_mtk = "/fragment@40/__overlay__/subpmic_ldo@64";
		subpmic_mtk = "/fragment@40/__overlay__/subpmic@34";
		subpmic_pmic_mtk = "/fragment@40/__overlay__/subpmic_pmic@1a";
		usb_c_pinctrl = "/fragment@5/__overlay__/usb_c_pinctrl";
		usb_default = "/fragment@18/__overlay__/usb_default";
		usb_type_c_mtk = "/fragment@40/__overlay__/usb_type_c@4e";
		vibrator0 = "/fragment@5/__overlay__/vibrator@0";
	};

	fragment@0 {
		target = <0xffffffff>;

		__overlay__ {
			enable-active-high;
			regulator-always-on;
			regulator-max-microvolt = <0x325aa0>;
			regulator-min-microvolt = <0x325aa0>;
			regulator-name = "mmc_power";
			status = "okay";
		};
	};

	fragment@1 {
		target = <0xffffffff>;

		__overlay__ {
			enable-active-high;
			regulator-always-on;
			regulator-max-microvolt = <0x1b7740>;
			regulator-min-microvolt = <0x1b7740>;
			regulator-name = "mmc_io";
			status = "okay";
		};
	};

	fragment@10 {
		target = <0xffffffff>;

		__overlay__ {
			pinctrl-0 = <0x15>;
			pinctrl-1 = <0x16>;
			pinctrl-names = "irtx_gpio_led_default", "irtx_gpio_led_set";
			status = "okay";
		};
	};

	fragment@11 {
		target = <0xffffffff>;

		__overlay__ {

			irtx_gpio_led_def@gpio127 {
				phandle = <0x15>;

				pins_cmd_dat {
					bias-disable;
					input-schmitt-enable = <0x0>;
					output-low;
					pinmux = <0x7f00>;
					slew-rate = <0x1>;
				};
			};

			irtx_gpio_led_set@gpio127 {
				phandle = <0x16>;

				pins_cmd_dat {
					output-high;
					pinmux = <0x7f02>;
					slew-rate = <0x1>;
				};
			};
		};
	};

	fragment@12 {
		target = <0xffffffff>;

		__overlay__ {
			#address-cells = <0x1>;
			#size-cells = <0x0>;

			fingerprint@0 {
				compatible = "goodix,goodix-fp";
				netlink-event = <0x1e>;
				power-type = <0x1>;
				reg = <0x0>;
				spi-max-frequency = <0x7a1200>;
				status = "okay";
				vfp-supply = <0xffffffff>;
			};
		};
	};

	fragment@13 {
		target = <0xffffffff>;

		__overlay__ {
			interrupt-parent = <0xffffffff>;
			interrupts = <0xf 0x1 0xf 0x0>;
			pinctrl-0 = <0x17>;
			pinctrl-1 = <0x18>;
			pinctrl-2 = <0x19>;
			pinctrl-3 = <0x1a>;
			pinctrl-names = "default", "reset_high", "reset_low", "eint_init";
			status = "okay";
		};
	};

	fragment@14 {
		target = <0xffffffff>;

		__overlay__ {

			state_default {
				phandle = <0x17>;
			};

			state_eint_init {
				phandle = <0x1a>;

				pins_cmd_dat {
					bias-pull-up = <0x66>;
					input-schmitt-enable;
					pinmux = <0xf00>;
					slew-rate = <0x0>;
				};
			};

			state_reset_high {
				phandle = <0x18>;

				pins_cmd_dat {
					output-high;
					pinmux = <0xe00>;
					slew-rate = <0x1>;
				};
			};

			state_reset_low {
				phandle = <0x19>;

				pins_cmd_dat {
					output-low;
					pinmux = <0xe00>;
					slew-rate = <0x1>;
				};
			};
		};
	};

	fragment@15 {
		target = <0xffffffff>;

		__overlay__ {
			mt6360,intr_gpio = <0xffffffff 0x18 0x0>;
			mt6360,intr_gpio_num = <0x18>;
		};
	};

	fragment@16 {
		target = <0xffffffff>;

		__overlay__ {
			pwr_off_seq = <0x4000202>;
		};
	};

	fragment@17 {
		target = <0xffffffff>;

		__overlay__ {
			mt6360pd,intr_gpio = <0xffffffff 0x19 0x0>;
			mt6360pd,intr_gpio_num = <0x19>;
		};
	};

	fragment@18 {
		target = <0xffffffff>;

		__overlay__ {

			c1_high {
				phandle = <0x5>;

				pins_cmd_dat {
					output-high;
					pinmux = <0x7100>;
					slew-rate = <0x1>;
				};
			};

			c1_highz {
				phandle = <0x4>;

				pins_cmd_dat {
					bias-disable;
					pinmux = <0x7100>;
					slew-rate = <0x0>;
				};
			};

			c1_init {
				phandle = <0x2>;

				pins_cmd_dat {
					output-low;
					pinmux = <0x7100>;
					slew-rate = <0x1>;
				};
			};

			c1_low {
				phandle = <0x3>;

				pins_cmd_dat {
					output-low;
					pinmux = <0x7100>;
					slew-rate = <0x1>;
				};
			};

			c2_high {
				phandle = <0x9>;

				pins_cmd_dat {
					output-high;
					pinmux = <0x7000>;
					slew-rate = <0x1>;
				};
			};

			c2_highz {
				phandle = <0x8>;

				pins_cmd_dat {
					bias-disable;
					pinmux = <0x7000>;
					slew-rate = <0x0>;
				};
			};

			c2_init {
				phandle = <0x6>;

				pins_cmd_dat {
					output-low;
					pinmux = <0x7000>;
					slew-rate = <0x1>;
				};
			};

			c2_low {
				phandle = <0x7>;

				pins_cmd_dat {
					output-low;
					pinmux = <0x7000>;
					slew-rate = <0x1>;
				};
			};

			u3_sw_dis {
				phandle = <0xd>;
			};

			u3_sw_en {
				phandle = <0xc>;
			};

			u3_sw_sel1 {
				phandle = <0xa>;

				pins_cmd_dat {
					output-low;
					pinmux = <0x6f00>;
					slew-rate = <0x1>;
				};
			};

			u3_sw_sel2 {
				phandle = <0xb>;

				pins_cmd_dat {
					output-high;
					pinmux = <0x6f00>;
					slew-rate = <0x1>;
				};
			};

			usb_default {
				phandle = <0x1>;
			};
		};
	};

	fragment@19 {
		target = <0xffffffff>;

		__overlay__ {

			gps_default {
				phandle = <0x1b>;
			};

			gps_l1_lna@0 {
				phandle = <0x1c>;

				pins_cmd_dat {
					output-low;
					pinmux = <0xa200>;
				};
			};

			gps_l1_lna@1 {
				phandle = <0x1d>;

				pins_cmd_dat {
					pinmux = <0xa202>;
				};
			};

			gps_l1_lna@2 {
				phandle = <0x1e>;

				pins_cmd_dat {
					output-high;
					pinmux = <0xa200>;
				};
			};

			gps_l5_lna@0 {
				phandle = <0x1f>;

				pins_cmd_dat {
					output-low;
					pinmux = <0xa300>;
				};
			};

			gps_l5_lna@1 {
				phandle = <0x20>;

				pins_cmd_dat {
					pinmux = <0xa302>;
				};
			};

			gps_l5_lna@2 {
				phandle = <0x21>;

				pins_cmd_dat {
					output-high;
					pinmux = <0xa300>;
				};
			};
		};
	};

	fragment@2 {
		target = <0xffffffff>;

		__overlay__ {
		};
	};

	fragment@20 {
		target = <0xffffffff>;

		__overlay__ {
			pinctrl-0 = <0x1b>;
			pinctrl-1 = <0x1c>;
			pinctrl-2 = <0x1d>;
			pinctrl-3 = <0x1e>;
			pinctrl-4 = <0x1f>;
			pinctrl-5 = <0x20>;
			pinctrl-6 = <0x21>;
			pinctrl-names = "default", "gps_l1_lna_disable", "gps_l1_lna_dsp_ctrl", "gps_l1_lna_enable", "gps_l5_lna_disable", "gps_l5_lna_dsp_ctrl", "gps_l5_lna_enable";
			status = "okay";
		};
	};

	fragment@21 {
		target = <0xffffffff>;

		__overlay__ {
			#address-cells = <0x1>;
			#size-cells = <0x0>;
			status = "okay";

			panel1@0 {
				bias-gpios = <0xffffffff 0x1d 0x0>;
				compatible = "oppo20615_samsung_ams643ye01_1080p_dsi_cmd";
				ldo3-supply = <0xffffffff>;
				pinctrl-names = "default";
				pm-enable-gpios = <0xffffffff 0x29 0x0>;
				reg = <0x0>;
				reset-gpios = <0xffffffff 0x2a 0x0>;

				port {

					endpoint {
						phandle = <0x23>;
						remote-endpoint = <0x22>;
					};
				};
			};

			ports {

				port {

					endpoint {
						phandle = <0x22>;
						remote-endpoint = <0x23>;
					};
				};
			};
		};
	};

	fragment@22 {
		target = <0xffffffff>;

		__overlay__ {
			cam2_enable_sensor = "imx586_mipi_raw s5k3m5sx_mipi_raw";
			cam4_enable_sensor = "imx586_mipi_raw imx481_mipi_raw";
		};
	};

	fragment@23 {
		target = <0xffffffff>;

		__overlay__ {
			clock-frequency = <0x61a80>;
			pinctrl-0 = <0x24>;
			pinctrl-1 = <0x25>;
			pinctrl-2 = <0x26>;
			pinctrl-3 = <0x27>;
			pinctrl-4 = <0x28>;
			pinctrl-5 = <0x29>;
			pinctrl-names = "default", "ts_int_active", "ts_reset_active", "ts_int_suspend", "ts_reset_suspend", "ts_i2c_mode";

			gt9886@5d {
				compatible = "goodix,gt9886";
				goodix,config-version = "6893v01";
				goodix,firmware-version = "6893v01";
				goodix,input-max-x = <0x438>;
				goodix,input-max-y = <0x8e8>;
				goodix,irq-flags = <0x2>;
				goodix,irq-gpio = <0xffffffff 0x15 0x0>;
				goodix,key-of-pen = <0x14b 0x14c>;
				goodix,panel-key-map = <0x9e 0xac 0xd9>;
				goodix,panel-max-id = <0xa>;
				goodix,panel-max-p = <0x100>;
				goodix,panel-max-w = <0x100>;
				goodix,panel-max-x = <0x438>;
				goodix,panel-max-y = <0x8e8>;
				goodix,pen-enable;
				goodix,power-off-delay-us = <0x1388>;
				goodix,power-on-delay-us = <0x2710>;
				goodix,reset-gpio = <0xffffffff 0x14 0x0>;
				interrupt-parent = <0xffffffff>;
				interrupts = <0x15 0x2 0x15 0x0>;
				reg = <0x5d>;
				status = "ok";
				tpd-filter-custom-prameters = <0x0 0x0 0x0 0x0 0x0 0x0 0x0 0x0 0x0 0x0 0x0 0x0>;
				tpd-filter-custom-speed = <0x0 0x0 0x0>;
				tpd-filter-enable = <0x0>;
				tpd-filter-pixel-density = <0xa1>;
				vtouch-supply = <0xffffffff>;
			};
		};
	};

	fragment@24 {
		target = <0xffffffff>;

		__overlay__ {
			#address-cells = <0x1>;
			#size-cells = <0x0>;
			pinctrl-0 = <0x2a>;
			pinctrl-1 = <0x2b>;
			pinctrl-2 = <0x2c>;
			pinctrl-3 = <0x2d>;
			pinctrl-4 = <0x2e>;
			pinctrl-5 = <0x2f>;
			pinctrl-names = "default", "gt9896s_int_active", "gt9896s_reset_active", "gt9896s_int_suspend", "gt9896s_reset_suspend", "gt9896s_spi_mode";
			status = "okay";

			gt9896s@0 {
				compatible = "goodix,gt9896s";
				goodix,avdd-name = "vtouch";
				goodix,config-version = "6893v02";
				goodix,firmware-version = "6893v02";
				goodix,input-max-x = <0x438>;
				goodix,input-max-y = <0x8fc>;
				goodix,irq-flags = <0x2>;
				goodix,irq-gpio = <0xffffffff 0x15 0x0>;
				goodix,panel-key-map = <0x9e 0xac 0xd9>;
				goodix,panel-max-id = <0xa>;
				goodix,panel-max-p = <0x100>;
				goodix,panel-max-w = <0x100>;
				goodix,panel-max-x = <0x438>;
				goodix,panel-max-y = <0x8fc>;
				goodix,pen-enable;
				goodix,power-off-delay-us = <0x1388>;
				goodix,power-on-delay-us = <0x2710>;
				goodix,reset-gpio = <0xffffffff 0x14 0x0>;
				reg = <0x0>;
				spi-max-frequency = <0xf4240>;
				tpd-filter-custom-prameters = <0x0 0x0 0x0 0x0 0x0 0x0 0x0 0x0 0x0 0x0 0x0 0x0>;
				tpd-filter-custom-speed = <0x0 0x0 0x0>;
				tpd-filter-enable = <0x0>;
				tpd-filter-pixel-density = <0xa1>;
				vtouch-supply = <0xffffffff>;
			};
		};
	};

	fragment@25 {
		target = <0xffffffff>;

		__overlay__ {

			eintdefault {
				phandle = <0x24>;
			};

			i2cmode_default {
				phandle = <0x29>;

				pins_cmd_dat {
					pinmux = <0xcc01 0xcd01>;
				};
			};

			int1_active {
				phandle = <0x2b>;

				pins_cmd_dat {
					input-enable;
					pinmux = <0x1500>;
				};
			};

			int1_suspend {
				phandle = <0x2d>;

				pins_cmd_dat {
					output-low;
					pinmux = <0x1500>;
				};
			};

			int_active {
				phandle = <0x25>;

				pins_cmd_dat {
					input-enable;
					pinmux = <0x1500>;
				};
			};

			int_high {
				phandle = <0x6e>;

				pins_cmd_dat {
					output-high;
					pinmux = <0x1500>;
				};
			};

			int_suspend {
				phandle = <0x27>;

				pins_cmd_dat {
					output-low;
					pinmux = <0x1500>;
				};
			};

			pins_default {
				phandle = <0x2a>;
			};

			reset1_active {
				phandle = <0x2c>;

				pins_cmd_dat {
					output-high;
					pinmux = <0x1400>;
				};
			};

			reset1_suspend {
				phandle = <0x2e>;

				pins_cmd_dat {
					output-low;
					pinmux = <0x1400>;
				};
			};

			reset_active {
				phandle = <0x26>;

				pins_cmd_dat {
					output-high;
					pinmux = <0x1400>;
				};
			};

			reset_suspend {
				phandle = <0x28>;

				pins_cmd_dat {
					output-low;
					pinmux = <0x1400>;
				};
			};

			spimode_default {
				phandle = <0x2f>;

				pins_cmd_dat {
					drive-strength = <0x2>;
					pinmux = <0x1202 0x1302 0xcc02 0xcd02>;
				};
			};
		};
	};

	fragment@26 {
		target = <0xffffffff>;

		__overlay__ {

			cam0@0 {
				phandle = <0x31>;

				pins_cmd_dat {
					output-low;
					pinmux = <0x9000>;
					slew-rate = <0x1>;
				};
			};

			cam0@1 {
				phandle = <0x32>;

				pins_cmd_dat {
					output-high;
					pinmux = <0x9000>;
					slew-rate = <0x1>;
				};
			};

			cam0@2 {
				phandle = <0x33>;

				pins_cmd_dat {
					output-low;
					pinmux = <0x9300>;
					slew-rate = <0x1>;
				};
			};

			cam0@3 {
				phandle = <0x34>;

				pins_cmd_dat {
					output-high;
					pinmux = <0x9300>;
					slew-rate = <0x1>;
				};
			};

			cam0@vcam0 {
				phandle = <0x41>;

				pins_cmd_dat {
					output-low;
					pinmux = <0x8a00>;
					slew-rate = <0x1>;
				};
			};

			cam0@vcam1 {
				phandle = <0x42>;

				pins_cmd_dat {
					output-high;
					pinmux = <0x8a00>;
					slew-rate = <0x1>;
				};
			};

			cam0@vcam2 {
				phandle = <0x43>;

				pins_cmd_dat {
					output-low;
					pinmux = <0x500>;
					slew-rate = <0x1>;
				};
			};

			cam0@vcam3 {
				phandle = <0x44>;

				pins_cmd_dat {
					output-high;
					pinmux = <0x500>;
					slew-rate = <0x1>;
				};
			};

			cam1@0 {
				phandle = <0x35>;

				pins_cmd_dat {
					output-low;
					pinmux = <0x8600>;
					slew-rate = <0x1>;
				};
			};

			cam1@1 {
				phandle = <0x36>;

				pins_cmd_dat {
					output-high;
					pinmux = <0x8600>;
					slew-rate = <0x1>;
				};
			};

			cam1@2 {
				phandle = <0x37>;

				pins_cmd_dat {
					output-low;
					pinmux = <0x8500>;
					slew-rate = <0x1>;
				};
			};

			cam1@3 {
				phandle = <0x38>;

				pins_cmd_dat {
					output-high;
					pinmux = <0x8500>;
					slew-rate = <0x1>;
				};
			};

			cam1@vcam0 {
				phandle = <0x45>;

				pins_cmd_dat {
					output-low;
					pinmux = <0x800>;
					slew-rate = <0x1>;
				};
			};

			cam1@vcam1 {
				phandle = <0x46>;

				pins_cmd_dat {
					output-high;
					pinmux = <0x800>;
					slew-rate = <0x1>;
				};
			};

			cam1@vcam2 {
				phandle = <0x47>;

				pins_cmd_dat {
					output-low;
					pinmux = <0x900>;
					slew-rate = <0x1>;
				};
			};

			cam1@vcam3 {
				phandle = <0x48>;

				pins_cmd_dat {
					output-high;
					pinmux = <0x900>;
					slew-rate = <0x1>;
				};
			};

			cam2@0 {
				phandle = <0x39>;

				pins_cmd_dat {
					output-low;
					pinmux = <0x8f00>;
					slew-rate = <0x1>;
				};
			};

			cam2@1 {
				phandle = <0x3a>;

				pins_cmd_dat {
					output-high;
					pinmux = <0x8f00>;
					slew-rate = <0x1>;
				};
			};

			cam2@2 {
				phandle = <0x3b>;

				pins_cmd_dat {
					output-low;
					pinmux = <0x9200>;
					slew-rate = <0x1>;
				};
			};

			cam2@3 {
				phandle = <0x3c>;

				pins_cmd_dat {
					output-high;
					pinmux = <0x9200>;
					slew-rate = <0x1>;
				};
			};

			cam2@vcam0 {
				phandle = <0x49>;

				pins_cmd_dat {
					output-low;
					pinmux = <0x8700>;
					slew-rate = <0x1>;
				};
			};

			cam2@vcam1 {
				phandle = <0x4a>;

				pins_cmd_dat {
					output-high;
					pinmux = <0x8700>;
					slew-rate = <0x1>;
				};
			};

			cam2@vcam2 {
				phandle = <0x4b>;

				pins_cmd_dat {
					output-low;
					pinmux = <0x8900>;
					slew-rate = <0x1>;
				};
			};

			cam2@vcam3 {
				phandle = <0x4c>;

				pins_cmd_dat {
					output-high;
					pinmux = <0x8900>;
					slew-rate = <0x1>;
				};
			};

			cam4@0 {
				phandle = <0x3d>;

				pins_cmd_dat {
					output-low;
					pinmux = <0x9100>;
					slew-rate = <0x1>;
				};
			};

			cam4@1 {
				phandle = <0x3e>;

				pins_cmd_dat {
					output-high;
					pinmux = <0x9100>;
					slew-rate = <0x1>;
				};
			};

			cam4@2 {
				phandle = <0x3f>;

				pins_cmd_dat {
					output-low;
					pinmux = <0x9400>;
					slew-rate = <0x1>;
				};
			};

			cam4@3 {
				phandle = <0x40>;

				pins_cmd_dat {
					output-high;
					pinmux = <0x9400>;
					slew-rate = <0x1>;
				};
			};

			cam4@vcam0 {
				phandle = <0x4d>;

				pins_cmd_dat {
					output-low;
					pinmux = <0x600>;
					slew-rate = <0x1>;
				};
			};

			cam4@vcam1 {
				phandle = <0x4e>;

				pins_cmd_dat {
					output-high;
					pinmux = <0x600>;
					slew-rate = <0x1>;
				};
			};

			cam4@vcam2 {
				phandle = <0x4f>;

				pins_cmd_dat {
					output-low;
					pinmux = <0x700>;
					slew-rate = <0x1>;
				};
			};

			cam4@vcam3 {
				phandle = <0x50>;

				pins_cmd_dat {
					output-high;
					pinmux = <0x700>;
					slew-rate = <0x1>;
				};
			};

			camdefault {
				phandle = <0x30>;
			};

			camera_pins_cam0_mclk_2ma {
				phandle = <0x52>;

				pins_cmd_dat {
					drive-strength = <0x0>;
					pinmux = <0x9601>;
				};
			};

			camera_pins_cam0_mclk_4ma {
				phandle = <0x53>;

				pins_cmd_dat {
					drive-strength = <0x1>;
					pinmux = <0x9601>;
				};
			};

			camera_pins_cam0_mclk_6ma {
				phandle = <0x54>;

				pins_cmd_dat {
					drive-strength = <0x2>;
					pinmux = <0x9601>;
				};
			};

			camera_pins_cam0_mclk_8ma {
				phandle = <0x55>;

				pins_cmd_dat {
					drive-strength = <0x3>;
					pinmux = <0x9601>;
				};
			};

			camera_pins_cam0_mclk_off {
				phandle = <0x51>;

				pins_cmd_dat {
					drive-strength = <0x1>;
					pinmux = <0x9600>;
				};
			};

			camera_pins_cam1_mclk_2ma {
				phandle = <0x57>;

				pins_cmd_dat {
					drive-strength = <0x0>;
					pinmux = <0x8801>;
				};
			};

			camera_pins_cam1_mclk_4ma {
				phandle = <0x58>;

				pins_cmd_dat {
					drive-strength = <0x1>;
					pinmux = <0x8801>;
				};
			};

			camera_pins_cam1_mclk_6ma {
				phandle = <0x59>;

				pins_cmd_dat {
					drive-strength = <0x2>;
					pinmux = <0x8801>;
				};
			};

			camera_pins_cam1_mclk_8ma {
				phandle = <0x5a>;

				pins_cmd_dat {
					drive-strength = <0x3>;
					pinmux = <0x8801>;
				};
			};

			camera_pins_cam1_mclk_off {
				phandle = <0x56>;

				pins_cmd_dat {
					drive-strength = <0x1>;
					pinmux = <0x8800>;
				};
			};

			camera_pins_cam2_mclk_2ma {
				phandle = <0x5c>;

				pins_cmd_dat {
					drive-strength = <0x0>;
					pinmux = <0x9501>;
				};
			};

			camera_pins_cam2_mclk_4ma {
				phandle = <0x5d>;

				pins_cmd_dat {
					drive-strength = <0x1>;
					pinmux = <0x9501>;
				};
			};

			camera_pins_cam2_mclk_6ma {
				phandle = <0x5e>;

				pins_cmd_dat {
					drive-strength = <0x2>;
					pinmux = <0x9501>;
				};
			};

			camera_pins_cam2_mclk_8ma {
				phandle = <0x5f>;

				pins_cmd_dat {
					drive-strength = <0x3>;
					pinmux = <0x9501>;
				};
			};

			camera_pins_cam2_mclk_off {
				phandle = <0x5b>;

				pins_cmd_dat {
					drive-strength = <0x1>;
					pinmux = <0x9500>;
				};
			};

			camera_pins_cam4_mclk_2ma {
				phandle = <0x61>;

				pins_cmd_dat {
					drive-strength = <0x0>;
					pinmux = <0x9701>;
				};
			};

			camera_pins_cam4_mclk_4ma {
				phandle = <0x62>;

				pins_cmd_dat {
					drive-strength = <0x1>;
					pinmux = <0x9701>;
				};
			};

			camera_pins_cam4_mclk_6ma {
				phandle = <0x63>;

				pins_cmd_dat {
					drive-strength = <0x2>;
					pinmux = <0x9701>;
				};
			};

			camera_pins_cam4_mclk_8ma {
				phandle = <0x64>;

				pins_cmd_dat {
					drive-strength = <0x3>;
					pinmux = <0x9701>;
				};
			};

			camera_pins_cam4_mclk_off {
				phandle = <0x60>;

				pins_cmd_dat {
					drive-strength = <0x1>;
					pinmux = <0x9700>;
				};
			};
		};
	};

	fragment@27 {
		target = <0xffffffff>;

		__overlay__ {
			cam0_vcamio-supply = <0xffffffff>;
			cam1_vcamio-supply = <0xffffffff>;
			cam2_vcamio-supply = <0xffffffff>;
			cam4_vcamio-supply = <0xffffffff>;
			pinctrl-0 = <0x30>;
			pinctrl-1 = <0x31>;
			pinctrl-10 = <0x3a>;
			pinctrl-11 = <0x3b>;
			pinctrl-12 = <0x3c>;
			pinctrl-13 = <0x3d>;
			pinctrl-14 = <0x3e>;
			pinctrl-15 = <0x3f>;
			pinctrl-16 = <0x40>;
			pinctrl-17 = <0x41>;
			pinctrl-18 = <0x42>;
			pinctrl-19 = <0x43>;
			pinctrl-2 = <0x32>;
			pinctrl-20 = <0x44>;
			pinctrl-21 = <0x45>;
			pinctrl-22 = <0x46>;
			pinctrl-23 = <0x47>;
			pinctrl-24 = <0x48>;
			pinctrl-25 = <0x49>;
			pinctrl-26 = <0x4a>;
			pinctrl-27 = <0x4b>;
			pinctrl-28 = <0x4c>;
			pinctrl-29 = <0x4d>;
			pinctrl-3 = <0x33>;
			pinctrl-30 = <0x4e>;
			pinctrl-31 = <0x4f>;
			pinctrl-32 = <0x50>;
			pinctrl-33 = <0x51>;
			pinctrl-34 = <0x52>;
			pinctrl-35 = <0x53>;
			pinctrl-36 = <0x54>;
			pinctrl-37 = <0x55>;
			pinctrl-38 = <0x56>;
			pinctrl-39 = <0x57>;
			pinctrl-4 = <0x34>;
			pinctrl-40 = <0x58>;
			pinctrl-41 = <0x59>;
			pinctrl-42 = <0x5a>;
			pinctrl-43 = <0x5b>;
			pinctrl-44 = <0x5c>;
			pinctrl-45 = <0x5d>;
			pinctrl-46 = <0x5e>;
			pinctrl-47 = <0x5f>;
			pinctrl-48 = <0x60>;
			pinctrl-49 = <0x61>;
			pinctrl-5 = <0x35>;
			pinctrl-50 = <0x62>;
			pinctrl-51 = <0x63>;
			pinctrl-52 = <0x64>;
			pinctrl-6 = <0x36>;
			pinctrl-7 = <0x37>;
			pinctrl-8 = <0x38>;
			pinctrl-9 = <0x39>;
			pinctrl-names = "default", "cam0_rst0", "cam0_rst1", "cam0_pnd0", "cam0_pnd1", "cam1_rst0", "cam1_rst1", "cam1_pnd0", "cam1_pnd1", "cam2_rst0", "cam2_rst1", "cam2_pnd0", "cam2_pnd1", "cam4_rst0", "cam4_rst1", "cam4_pnd0", "cam4_pnd1", "cam0_ldo_vcamd_0", "cam0_ldo_vcamd_1", "cam0_ldo_vcama_0", "cam0_ldo_vcama_1", "cam1_ldo_vcamd_0", "cam1_ldo_vcamd_1", "cam1_ldo_vcama_0", "cam1_ldo_vcama_1", "cam2_ldo_vcamd_0", "cam2_ldo_vcamd_1", "cam2_ldo_vcama_0", "cam2_ldo_vcama_1", "cam4_ldo_vcamd_0", "cam4_ldo_vcamd_1", "cam4_ldo_vcama_0", "cam4_ldo_vcama_1", "cam0_mclk_off", "cam0_mclk_2mA", "cam0_mclk_4mA", "cam0_mclk_6mA", "cam0_mclk_8mA", "cam1_mclk_off", "cam1_mclk_2mA", "cam1_mclk_4mA", "cam1_mclk_6mA", "cam1_mclk_8mA", "cam2_mclk_off", "cam2_mclk_2mA", "cam2_mclk_4mA", "cam2_mclk_6mA", "cam2_mclk_8mA", "cam4_mclk_off", "cam4_mclk_2mA", "cam4_mclk_4mA", "cam4_mclk_6mA", "cam4_mclk_8mA";
			status = "okay";
		};
	};

	fragment@28 {
		target = <0xffffffff>;

		__overlay__ {

			camera_eeprom2@50 {
				compatible = "mediatek,camera_eeprom";
				phandle = <0x6f>;
				reg = <0x50>;
				status = "okay";
			};
		};
	};

	fragment@29 {
		target = <0xffffffff>;

		__overlay__ {

			camera_eeprom1@51 {
				compatible = "mediatek,camera_eeprom";
				phandle = <0x70>;
				reg = <0x51>;
				status = "okay";
			};
		};
	};

	fragment@3 {
		target = <0xffffffff>;

		__overlay__ {
			atag,videolfb-fb_base_h = <0x0>;
			atag,videolfb-fb_base_l = <0x7e020000>;
			atag,videolfb-fps = <0x1770>;
			atag,videolfb-islcm_inited = <0x0>;
			atag,videolfb-islcmfound = <0x1>;
			atag,videolfb-lcmname = "nt35595_fhd_dsi_cmd_truly_nt50358_drv";
			atag,videolfb-vramSize = <0x1be0000>;
		};
	};

	fragment@30 {
		target = <0xffffffff>;

		__overlay__ {

			camera_eeprom0@50 {
				compatible = "mediatek,camera_eeprom";
				phandle = <0x71>;
				reg = <0x50>;
				status = "okay";
			};
		};
	};

	fragment@31 {
		target = <0xffffffff>;

		__overlay__ {

			camera_eeprom4@51 {
				compatible = "mediatek,camera_eeprom";
				phandle = <0x72>;
				reg = <0x51>;
				status = "okay";
			};
		};
	};

	fragment@32 {
		target = <0xffffffff>;

		__overlay__ {

			adc_channel@ {
				compatible = "mediatek,adc_channel";
				mediatek,adc_fdd_rf_params_dynamic_custom_ch = <0x2>;
				mediatek,temperature0 = <0x0>;
				mediatek,temperature1 = <0x1>;
				status = "okay";
			};
		};
	};

	fragment@33 {
		target = <0xffffffff>;

		__overlay__ {
			io-channels = <0xffffffff 0x2>;
		};
	};

	fragment@34 {
		target = <0xffffffff>;

		__overlay__ {
			mediatek,clkbuf-config = <0x2 0x1 0x1 0x2 0x0 0x0 0x1>;
			mediatek,clkbuf-controls-for-desense = <0x0 0x4 0x0 0x4 0x0 0x0 0x0>;
			mediatek,clkbuf-output-impedance = <0x3 0x4 0x3 0x4 0x0 0x0 0x3>;
			mediatek,clkbuf-quantity = <0x7>;
			status = "okay";
		};
	};

	fragment@35 {
		target = <0xffffffff>;

		__overlay__ {
			#address-cells = <0x1>;
			#size-cells = <0x0>;
			clock-frequency = <0x61a80>;
			mediatek,use-open-drain;
		};
	};

	fragment@36 {
		target = <0xffffffff>;

		__overlay__ {
			#address-cells = <0x1>;
			#size-cells = <0x0>;
			clock-frequency = <0x61a80>;
			mediatek,use-open-drain;
		};
	};

	fragment@37 {
		target = <0xffffffff>;

		__overlay__ {
			#address-cells = <0x1>;
			#size-cells = <0x0>;
			clock-frequency = <0x61a80>;
			mediatek,use-push-pull;

			camera_main@21 {
				compatible = "mediatek,camera_main";
				phandle = <0x75>;
				reg = <0x21>;
				status = "okay";
			};

			camera_main_af@19 {
				compatible = "mediatek,camera_main_af";
				phandle = <0x77>;
				reg = <0x19>;
				status = "okay";
			};

			camera_main_eeprom@a1 {
				compatible = "mediatek,camera_main_eeprom";
				phandle = <0x76>;
				reg = <0xa1>;
				status = "okay";
			};

			camera_sub_two@7b {
				compatible = "mediatek,camera_sub_two";
				phandle = <0x73>;
				reg = <0x7b>;
				status = "okay";
			};

			camera_sub_two_eeprom@a5 {
				compatible = "mediatek,camera_sub_two_eeprom";
				phandle = <0x74>;
				reg = <0xa5>;
				status = "okay";
			};
		};
	};

	fragment@38 {
		target = <0xffffffff>;

		__overlay__ {
			#address-cells = <0x1>;
			#size-cells = <0x0>;
			clock-frequency = <0x61a80>;
			mediatek,use-open-drain;

			nfc@08 {
				compatible = "mediatek,nfc";
				phandle = <0x78>;
				reg = <0x8>;
				status = "okay";
			};
		};
	};

	fragment@39 {
		target = <0xffffffff>;

		__overlay__ {
			#address-cells = <0x1>;
			#size-cells = <0x0>;
			clock-frequency = <0x61a80>;
			mediatek,use-push-pull;

			camera_main_two@45 {
				compatible = "mediatek,camera_main_two";
				phandle = <0x79>;
				reg = <0x45>;
				status = "okay";
			};

			camera_main_two_eeprom@a3 {
				compatible = "mediatek,camera_main_two_eeprom";
				phandle = <0x7a>;
				reg = <0xa3>;
				status = "okay";
			};

			camera_sub@21 {
				compatible = "mediatek,camera_sub";
				phandle = <0x7b>;
				reg = <0x21>;
				status = "okay";
			};

			camera_sub_eeprom@a9 {
				compatible = "mediatek,camera_sub_eeprom";
				phandle = <0x7c>;
				reg = <0xa9>;
				status = "okay";
			};
		};
	};

	fragment@4 {
		target = <0xffffffff>;

		__overlay__ {
			bus-width = <0x8>;
			cap-mmc-highspeed;
			max-frequency = <0x4c4b40>;
			no-sd;
			no-sdio;
			non-removable;
			status = "okay";
			vmmc-supply = <0xffffffff>;
			vqmmc-supply = <0xffffffff>;
		};
	};

	fragment@40 {
		target = <0xffffffff>;

		__overlay__ {
			#address-cells = <0x1>;
			#size-cells = <0x0>;
			clock-frequency = <0x33e140>;
			mediatek,use-push-pull;

			subpmic@34 {
				compatible = "mediatek,subpmic";
				phandle = <0x7d>;
				reg = <0x34>;
				status = "okay";
			};

			subpmic_ldo@64 {
				compatible = "mediatek,subpmic_ldo";
				phandle = <0x80>;
				reg = <0x64>;
				status = "okay";
			};

			subpmic_pmic@1a {
				compatible = "mediatek,subpmic_pmic";
				phandle = <0x7f>;
				reg = <0x1a>;
				status = "okay";
			};

			usb_type_c@4e {
				compatible = "mediatek,usb_type_c";
				phandle = <0x7e>;
				reg = <0x4e>;
				status = "okay";
			};
		};
	};

	fragment@41 {
		target = <0xffffffff>;

		__overlay__ {
			#address-cells = <0x1>;
			#size-cells = <0x0>;
			clock-frequency = <0x61a80>;
			mediatek,use-open-drain;

			dp_switch@50 {
				compatible = "mediatek,dp_switch";
				phandle = <0x82>;
				reg = <0x50>;
				status = "okay";
			};

			ext_buck_vmddr@61 {
				compatible = "mediatek,ext_buck_vmddr";
				phandle = <0x83>;
				reg = <0x61>;
				status = "okay";
			};

			i2c_lcd_bias@3e {
				compatible = "mediatek,i2c_lcd_bias";
				phandle = <0x81>;
				reg = <0x3e>;
				status = "okay";
			};
		};
	};

	fragment@42 {
		target = <0xffffffff>;

		__overlay__ {
			#address-cells = <0x1>;
			#size-cells = <0x0>;
			clock-frequency = <0x186a0>;
			mediatek,use-open-drain;
		};
	};

	fragment@43 {
		target = <0xffffffff>;

		__overlay__ {
			#address-cells = <0x1>;
			#size-cells = <0x0>;
			clock-frequency = <0x61a80>;
			mediatek,use-open-drain;

			fan53870@6b {
				compatible = "mediatek,fan53870";
				phandle = <0x84>;
				reg = <0x6b>;
				status = "okay";
			};
		};
	};

	fragment@44 {
		target = <0xffffffff>;

		__overlay__ {
			#address-cells = <0x1>;
			#size-cells = <0x0>;
			clock-frequency = <0x61a80>;
			mediatek,use-open-drain;

			camera_main_three@10 {
				compatible = "mediatek,camera_main_three";
				phandle = <0x85>;
				reg = <0x10>;
				status = "okay";
			};

			camera_main_three_eeprom@51 {
				compatible = "mediatek,camera_main_three_eeprom";
				phandle = <0x86>;
				reg = <0x51>;
				status = "okay";
			};
		};
	};

	fragment@45 {
		target = <0xffffffff>;

		__overlay__ {
			GPIO_FDD_BAND_SUPPORT_DETECT_1ST_PIN = <0xffffffff 0x3f 0x0>;
			GPIO_FDD_BAND_SUPPORT_DETECT_2ND_PIN = <0xffffffff 0x40 0x0>;
			GPIO_FDD_BAND_SUPPORT_DETECT_3RD_PIN = <0xffffffff 0x41 0x0>;
			GPIO_FDD_BAND_SUPPORT_DETECT_4TH_PIN = <0xffffffff 0x42 0x0>;
			GPIO_SIM1_HOT_PLUG = <0xffffffff 0x2b 0x0>;
			GPIO_SIM1_SCLK = <0xffffffff 0x32 0x0>;
			GPIO_SIM1_SIO = <0xffffffff 0x30 0x0>;
			GPIO_SIM1_SRST = <0xffffffff 0x31 0x0>;
			GPIO_SIM2_SCLK = <0xffffffff 0x2d 0x0>;
			GPIO_SIM2_SIO = <0xffffffff 0x2f 0x0>;
			GPIO_SIM2_SRST = <0xffffffff 0x2e 0x0>;
		};
	};

	fragment@46 {
		target = <0xffffffff>;

		__overlay__ {
			gpio_init_default = <0x0 0x0 0x0 0x0 0x1 0x1 0x1 0x1 0x0 0x0 0x0 0x1 0x0 0x1 0x2 0x0 0x0 0x0 0x1 0x0 0x1 0x3 0x0 0x0 0x0 0x1 0x0 0x1 0x4 0x0 0x0 0x0 0x1 0x1 0x1 0x5 0x0 0x1 0x0 0x1 0x0 0x1 0x6 0x0 0x1 0x0 0x1 0x0 0x0 0x7 0x0 0x0 0x0 0x0 0x0 0x1 0x8 0x0 0x1 0x0 0x1 0x0 0x1 0x9 0x0 0x1 0x0 0x0 0x0 0x0 0xa 0x0 0x1 0x0 0x1 0x0 0x1 0xb 0x0 0x0 0x0 0x1 0x0 0x0 0xc 0x0 0x1 0x0 0x1 0x0 0x1 0xd 0x0 0x1 0x0 0x1 0x0 0x1 0xe 0x0 0x1 0x0 0x1 0x0 0x0 0xf 0x0 0x0 0x0 0x1 0x0 0x0 0x10 0x0 0x1 0x0 0x1 0x0 0x0 0x11 0x1 0x0 0x0 0x1 0x0 0x0 0x12 0x2 0x0 0x0 0x1 0x0 0x1 0x13 0x2 0x0 0x0 0x0 0x0 0x1 0x14 0x0 0x1 0x0 0x1 0x0 0x1 0x15 0x0 0x0 0x0 0x1 0x1 0x1 0x16 0x0 0x0 0x0 0x1 0x0 0x1 0x17 0x0 0x0 0x0 0x1 0x1 0x1 0x18 0x0 0x0 0x0 0x1 0x1 0x1 0x19 0x0 0x0 0x0 0x1 0x1 0x1 0x1a 0x0 0x1 0x0 0x1 0x0 0x1 0x1b 0x0 0x1 0x0 0x1 0x0 0x0 0x1c 0x0 0x1 0x0 0x1 0x0 0x1 0x1d 0x0 0x1 0x0 0x1 0x0 0x1 0x1e 0x0 0x1 0x0 0x1 0x0 0x1 0x1f 0x0 0x0 0x0 0x1 0x1 0x1 0x20 0x1 0x0 0x0 0x0 0x0 0x1 0x21 0x1 0x0 0x0 0x0 0x0 0x1 0x22 0x1 0x0 0x0 0x1 0x0 0x1 0x23 0x1 0x0 0x0 0x0 0x0 0x1 0x24 0x1 0x1 0x0 0x0 0x0 0x0 0x25 0x1 0x1 0x0 0x0 0x0 0x0 0x26 0x1 0x0 0x0 0x1 0x1 0x0 0x27 0x1 0x1 0x0 0x1 0x0 0x0 0x28 0x1 0x0 0x0 0x0 0x0 0x0 0x29 0x1 0x0 0x0 0x1 0x0 0x0 0x2a 0x1 0x0 0x0 0x0 0x0 0x0 0x2b 0x1 0x0 0x0 0x1 0x1 0x1 0x2c 0x0 0x0 0x0 0x1 0x0 0x0 0x2d 0x1 0x0 0x0 0x0 0x0 0x1 0x2e 0x1 0x0 0x0 0x0 0x0 0x1 0x2f 0x1 0x0 0x0 0x1 0x1 0x1 0x30 0x1 0x0 0x0 0x1 0x1 0x1 0x31 0x1 0x0 0x0 0x0 0x0 0x1 0x32 0x1 0x0 0x0 0x0 0x0 0x1 0x33 0x0 0x1 0x0 0x1 0x0 0x1 0x34 0x1 0x0 0x0 0x1 0x1 0x1 0x35 0x1 0x0 0x0 0x1 0x1 0x1 0x36 0x1 0x0 0x0 0x1 0x1 0x1 0x37 0x1 0x0 0x0 0x1 0x1 0x1 0x38 0x0 0x1 0x0 0x1 0x0 0x1 0x39 0x1 0x0 0x0 0x1 0x0 0x0 0x3a 0x1 0x0 0x0 0x1 0x0 0x0 0x3b 0x1 0x0 0x0 0x1 0x0 0x1 0x3c 0x1 0x0 0x0 0x1 0x0 0x1 0x3d 0x1 0x0 0x0 0x1 0x0 0x0 0x3e 0x1 0x0 0x0 0x1 0x0 0x1 0x3f 0x0 0x0 0x0 0x1 0x0 0x0 0x40 0x0 0x0 0x0 0x1 0x0 0x0 0x41 0x0 0x0 0x0 0x1 0x0 0x0 0x42 0x0 0x0 0x0 0x1 0x0 0x0 0x43 0x1 0x0 0x0 0x1 0x0 0x0 0x44 0x0 0x1 0x1 0x1 0x0 0x0 0x45 0x1 0x0 0x0 0x1 0x0 0x0 0x46 0x1 0x0 0x0 0x1 0x0 0x0 0x47 0x1 0x0 0x0 0x1 0x0 0x0 0x48 0x0 0x0 0x0 0x1 0x1 0x0 0x49 0x1 0x0 0x0 0x1 0x0 0x0 0x4a 0x1 0x0 0x0 0x1 0x0 0x0 0x4b 0x1 0x0 0x0 0x1 0x0 0x0 0x4c 0x1 0x0 0x0 0x1 0x0 0x0 0x4d 0x1 0x0 0x0 0x1 0x0 0x0 0x4e 0x1 0x0 0x0 0x1 0x0 0x0 0x4f 0x1 0x0 0x0 0x1 0x0 0x0 0x50 0x1 0x0 0x0 0x1 0x0 0x0 0x51 0x1 0x0 0x0 0x1 0x0 0x0 0x52 0x1 0x0 0x0 0x1 0x0 0x0 0x53 0x1 0x0 0x0 0x1 0x0 0x0 0x54 0x1 0x0 0x0 0x1 0x0 0x0 0x55 0x1 0x0 0x0 0x1 0x0 0x0 0x56 0x1 0x0 0x0 0x1 0x0 0x0 0x57 0x1 0x0 0x0 0x1 0x0 0x0 0x58 0x1 0x0 0x0 0x1 0x0 0x0 0x59 0x1 0x0 0x0 0x0 0x0 0x1 0x5a 0x1 0x0 0x0 0x0 0x0 0x1 0x5c 0x1 0x0 0x0 0x0 0x0 0x0 0x5d 0x1 0x0 0x0 0x0 0x0 0x0 0x5e 0x0 0x0 0x0 0x1 0x0 0x1 0x5f 0x0 0x1 0x0 0x1 0x0 0x1 0x60 0x7 0x0 0x0 0x1 0x0 0x0 0x61 0x7 0x0 0x0 0x1 0x0 0x0 0x62 0x7 0x0 0x0 0x1 0x0 0x0 0x63 0x7 0x0 0x0 0x0 0x0 0x0 0x64 0x7 0x0 0x0 0x1 0x0 0x0 0x65 0x7 0x0 0x0 0x1 0x0 0x0 0x66 0x7 0x0 0x0 0x1 0x0 0x0 0x67 0x7 0x0 0x0 0x0 0x0 0x0 0x68 0x7 0x0 0x0 0x1 0x0 0x0 0x69 0x7 0x0 0x0 0x1 0x0 0x0 0x6a 0x7 0x0 0x0 0x1 0x0 0x0 0x6b 0x7 0x0 0x0 0x1 0x0 0x1 0x6c 0x7 0x0 0x0 0x1 0x0 0x0 0x6d 0x7 0x0 0x0 0x1 0x0 0x0 0x6e 0x0 0x1 0x0 0x1 0x0 0x0 0x6f 0x0 0x1 0x0 0x1 0x0 0x0 0x70 0x0 0x1 0x0 0x1 0x0 0x0 0x71 0x0 0x1 0x0 0x1 0x0 0x0 0x72 0x2 0x0 0x0 0x1 0x0 0x0 0x73 0x2 0x0 0x0 0x0 0x0 0x0 0x74 0x2 0x0 0x0 0x0 0x0 0x0 0x75 0x2 0x0 0x0 0x0 0x0 0x0 0x76 0x2 0x0 0x0 0x1 0x1 0x1 0x77 0x2 0x0 0x0 0x1 0x1 0x1 0x78 0x1 0x0 0x0 0x1 0x1 0x1 0x79 0x1 0x0 0x0 0x1 0x1 0x1 0x7a 0x1 0x0 0x0 0x1 0x1 0x1 0x7b 0x1 0x0 0x0 0x1 0x1 0x1 0x7c 0x1 0x0 0x0 0x1 0x1 0x1 0x7d 0x1 0x0 0x0 0x1 0x1 0x1 0x7e 0x0 0x1 0x0 0x1 0x0 0x0 0x7f 0x4 0x0 0x0 0x1 0x0 0x0 0x80 0x0 0x1 0x0 0x1 0x0 0x0 0x81 0x0 0x1 0x0 0x1 0x0 0x0 0x82 0x1 0x0 0x0 0x1 0x0 0x0 0x83 0x0 0x1 0x0 0x1 0x0 0x0 0x84 0x1 0x0 0x0 0x1 0x0 0x0 0x85 0x7 0x0 0x0 0x1 0x0 0x1 0x86 0x0 0x1 0x0 0x1 0x0 0x0 0x87 0x0 0x1 0x0 0x1 0x0 0x0 0x88 0x1 0x0 0x0 0x0 0x0 0x0 0x89 0x0 0x1 0x0 0x1 0x0 0x0 0x8a 0x0 0x1 0x0 0x1 0x0 0x0 0x8b 0x1 0x0 0x0 0x1 0x1 0x1 0x8c 0x1 0x0 0x0 0x1 0x1 0x1 0x8d 0x1 0x0 0x0 0x1 0x1 0x1 0x8e 0x1 0x0 0x0 0x1 0x1 0x1 0x8f 0x0 0x1 0x0 0x1 0x0 0x0 0x90 0x0 0x1 0x0 0x1 0x0 0x0 0x91 0x0 0x1 0x0 0x1 0x0 0x0 0x92 0x0 0x1 0x0 0x1 0x0 0x0 0x93 0x0 0x1 0x0 0x1 0x0 0x0 0x94 0x0 0x1 0x0 0x1 0x0 0x0 0x95 0x0 0x1 0x0 0x1 0x0 0x0 0x96 0x0 0x1 0x0 0x1 0x0 0x0 0x97 0x0 0x1 0x0 0x1 0x0 0x0 0x98 0x0 0x0 0x0 0x1 0x0 0x0 0x99 0x1 0x0 0x0 0x0 0x0 0x0 0x9a 0x1 0x0 0x0 0x1 0x1 0x0 0x9b 0x1 0x0 0x0 0x1 0x1 0x0 0x9c 0x1 0x0 0x0 0x0 0x0 0x0 0x9d 0x0 0x1 0x0 0x1 0x0 0x0 0x9e 0x1 0x0 0x0 0x1 0x0 0x0 0x9f 0x1 0x0 0x0 0x0 0x0 0x0 0xa0 0x1 0x0 0x0 0x1 0x1 0x1 0xa1 0x1 0x0 0x0 0x1 0x1 0x1 0xa2 0x0 0x0 0x0 0x1 0x0 0x1 0xa3 0x0 0x0 0x0 0x1 0x0 0x1 0xa4 0x0 0x0 0x0 0x1 0x0 0x1 0xa5 0x1 0x0 0x0 0x1 0x0 0x1 0xa6 0x1 0x0 0x0 0x1 0x0 0x1 0xa7 0x0 0x0 0x0 0x1 0x0 0x1 0xa8 0x6 0x0 0x0 0x1 0x1 0x1 0xa9 0x6 0x0 0x0 0x1 0x1 0x1 0xaa 0x6 0x0 0x0 0x1 0x1 0x1 0xab 0x6 0x0 0x0 0x1 0x1 0x1 0xac 0x0 0x0 0x0 0x1 0x0 0x0 0xad 0x0 0x0 0x0 0x1 0x0 0x0 0xae 0x0 0x0 0x0 0x1 0x0 0x0 0xaf 0x0 0x0 0x0 0x1 0x0 0x0 0xb0 0x0 0x0 0x0 0x1 0x0 0x0 0xb1 0x0 0x0 0x0 0x1 0x0 0x0 0xb2 0x0 0x0 0x0 0x1 0x0 0x0 0xb3 0x0 0x0 0x0 0x1 0x0 0x0 0xb4 0x0 0x0 0x0 0x1 0x0 0x0 0xb5 0x0 0x0 0x0 0x1 0x0 0x0 0xb6 0x0 0x0 0x0 0x1 0x0 0x0 0xb7 0x0 0x1 0x1 0x1 0x0 0x1 0xbd 0x0 0x1 0x0 0x1 0x0 0x1 0xbf 0x0 0x1 0x0 0x1 0x0 0x1 0xc0 0x0 0x1 0x0 0x1 0x0 0x1 0xc3 0x1 0x0 0x0 0x0 0x0 0x0 0xc4 0x1 0x0 0x0 0x0 0x0 0x1 0xc5 0x1 0x0 0x0 0x0 0x0 0x1 0xc6 0x1 0x0 0x0 0x0 0x0 0x1 0xc7 0x1 0x0 0x0 0x1 0x0 0x1 0xc8 0x3 0x0 0x0 0x1 0x1 0x1 0xc9 0x3 0x0 0x0 0x1 0x1 0x1 0xca 0x1 0x0 0x0 0x1 0x1 0x1 0xcb 0x1 0x0 0x0 0x1 0x1 0x1 0xcc 0x1 0x0 0x0 0x1 0x1 0x1 0xcd 0x1 0x0 0x0 0x1 0x1 0x1 0xce 0x1 0x0 0x0 0x0 0x0 0x0 0xcf 0x1 0x0 0x0 0x0 0x0 0x0 0xd0 0x1 0x0 0x0 0x0 0x0 0x0 0xd1 0x1 0x0 0x0 0x1 0x0 0x0 0xd2 0x1 0x0 0x0 0x0 0x0 0x0 0xd3 0x1 0x0 0x0 0x0 0x0 0x0 0xd4 0x1 0x0 0x0 0x0 0x0 0x0 0xd5 0x1 0x0 0x0 0x1 0x0 0x0 0xd6 0x1 0x0 0x0 0x0 0x0 0x1 0xd7 0x1 0x0 0x0 0x0 0x0 0x1 0xd8 0x1 0x0 0x0 0x0 0x0 0x1 0xd9 0x1 0x0 0x0 0x0 0x0 0x1 0xda 0x1 0x0 0x0 0x1 0x0 0x1 0xdb 0x1 0x0 0x0 0x1 0x0 0x1 0xdc 0x0 0x0 0x0 0x1 0x0 0x0 0xdd 0x0 0x0 0x0 0x1 0x0 0x0 0xde 0x0 0x0 0x0 0x1 0x0 0x0 0xdf 0x0 0x0 0x0 0x1 0x0 0x0 0xe0 0x0 0x0 0x0 0x1 0x0 0x0 0xe1 0x0 0x0 0x0 0x1 0x0 0x0 0xe2 0x0 0x0 0x0 0x1 0x0 0x0>;
		};
	};

	fragment@47 {
		target = <0xffffffff>;

		__overlay__ {
			deb-gpios = <0xffffffff 0x0 0x0>;
			debounce = <0x7d000>;
			interrupt-parent = <0xffffffff>;
			interrupts = <0x0 0x8 0x0 0x0>;
			status = "okay";
		};
	};

	fragment@48 {
		target = <0xffffffff>;

		__overlay__ {
			interrupt-parent = <0xffffffff>;
			interrupts = <0x7 0x1 0x7 0x0>;
			status = "okay";
		};
	};

	fragment@49 {
		target = <0xffffffff>;

		__overlay__ {
			interrupt-parent = <0xffffffff>;
			interrupts = <0x15 0x2 0x15 0x0>;
			status = "okay";
		};
	};

	fragment@5 {
		target = <0xffffffff>;

		__overlay__ {

			led@0 {
				compatible = "mediatek,red";
				data = <0x1>;
				led_mode = <0x0>;
				phandle = <0x65>;
				pwm_config = <0x0 0x0 0x0 0x0 0x0>;
			};

			led@1 {
				compatible = "mediatek,green";
				data = <0x1>;
				led_mode = <0x0>;
				phandle = <0x66>;
				pwm_config = <0x0 0x0 0x0 0x0 0x0>;
			};

			led@2 {
				compatible = "mediatek,blue";
				data = <0x1>;
				led_mode = <0x0>;
				phandle = <0x67>;
				pwm_config = <0x0 0x0 0x0 0x0 0x0>;
			};

			led@3 {
				compatible = "mediatek,jogball-backlight";
				data = <0x1>;
				led_mode = <0x0>;
				phandle = <0x68>;
				pwm_config = <0x0 0x0 0x0 0x0 0x0>;
			};

			led@4 {
				compatible = "mediatek,keyboard-backlight";
				data = <0x1>;
				led_mode = <0x0>;
				phandle = <0x69>;
				pwm_config = <0x0 0x0 0x0 0x0 0x0>;
			};

			led@5 {
				compatible = "mediatek,button-backlight";
				data = <0x1>;
				led_mode = <0x0>;
				phandle = <0x6a>;
				pwm_config = <0x0 0x0 0x0 0x0 0x0>;
			};

			led@6 {
				compatible = "mediatek,lcd-backlight";
				data = <0x1>;
				led_mode = <0x4>;
				phandle = <0x6b>;
				pwm_config = <0x0 0x1 0x0 0x0 0x0>;
			};

			usb_c_pinctrl {
				compatible = "mediatek,usb_c_pinctrl";
				phandle = <0x6d>;
				pinctrl-0 = <0x1>;
				pinctrl-1 = <0x2>;
				pinctrl-10 = <0xb>;
				pinctrl-11 = <0xc>;
				pinctrl-12 = <0xd>;
				pinctrl-2 = <0x3>;
				pinctrl-3 = <0x4>;
				pinctrl-4 = <0x5>;
				pinctrl-5 = <0x6>;
				pinctrl-6 = <0x7>;
				pinctrl-7 = <0x8>;
				pinctrl-8 = <0x9>;
				pinctrl-9 = <0xa>;
				pinctrl-names = "usb_default", "redrv_c1_init", "redrv_c1_low", "redrv_c1_hiz", "redrv_c1_high", "redrv_c2_init", "redrv_c2_low", "redrv_c2_hiz", "redrv_c2_high", "switch_sel1", "switch_sel2", "switch_enable", "switch_disable";
				status = "okay";

				usb_switch-data {
					c1_pin_num = <0x71>;
					c1_pin_val = <0x2>;
					c2_pin_num = <0x70>;
					c2_pin_val = <0x1>;
					en_pin_num = <0x0>;
					en_pin_val = <0x0>;
					sel_pin_num = <0x6f>;
					sel_pin_val = <0x1>;
				};
			};

			vibrator@0 {
				compatible = "mediatek,vibrator";
				phandle = <0x6c>;
				vib_limit = <0x9>;
				vib_timer = <0x19>;
				vib_vol = <0x9>;
			};
		};
	};

	fragment@50 {
		target = <0xffffffff>;

		__overlay__ {
			interrupt-parent = <0xffffffff>;
			interrupts = <0x18 0x2 0x18 0x0>;
			status = "okay";
		};
	};

	fragment@51 {
		target = <0xffffffff>;

		__overlay__ {
			interrupt-parent = <0xffffffff>;
			interrupts = <0x19 0x2 0x19 0x0>;
			status = "okay";
		};
	};

	fragment@52 {
		target = <0xffffffff>;

		__overlay__ {
			interrupt-parent = <0xffffffff>;
			interrupts = <0x1f 0x8 0x1f 0x0>;
			status = "okay";
		};
	};

	fragment@53 {
		target = <0xffffffff>;

		__overlay__ {
			interrupt-parent = <0xffffffff>;
			interrupts = <0x29 0x1 0x29 0x1>;
			status = "okay";
		};
	};

	fragment@54 {
		target = <0xffffffff>;

		__overlay__ {
			deb-gpios = <0xffffffff 0x48 0x0>;
			interrupt-parent = <0xffffffff>;
			interrupts = <0x48 0x4 0x48 0x0>;
			status = "okay";
		};
	};

	fragment@55 {
		target = <0xffffffff>;

		__overlay__ {
			compatible = "mediatek,md1_sim1_hot_plug_eint-eint";
			debounce = <0x0 0x2710>;
			dedicated = <0x0 0x0>;
			interrupts = <0x0 0x8>;
			sockettype = <0x0 0x0>;
			src_pin = <0x0 0x1>;
			status = "okay";
		};
	};

	fragment@56 {
		target = <0xffffffff>;

		__overlay__ {
			regulator-default-on = <0x1>;
			regulator-name = "vcamio";
			status = "okay";
		};
	};

	fragment@57 {
		target = <0xffffffff>;

		__overlay__ {
			regulator-default-on = <0x1>;
			regulator-name = "vtp";
			status = "okay";
		};
	};

	fragment@58 {
		target = <0xffffffff>;

		__overlay__ {
			status = "okay";
			vcamaf-supply = <0xffffffff>;
			vcamaf_main2-supply = <0xffffffff>;
			vcamio-supply = <0xffffffff>;
			vcamio_main2-supply = <0xffffffff>;
			vcamio_sub-supply = <0xffffffff>;
		};
	};

	fragment@59 {
		target = <0xffffffff>;

		__overlay__ {
			status = "okay";
			vtouch-supply = <0xffffffff>;
		};
	};

	fragment@6 {
		target = <0xffffffff>;

		__overlay__ {

			lcd_bias_enn0_gpio {
				phandle = <0x11>;

				pins_cmd_dat {
					output-low;
					pinmux = <0x1d00>;
					slew-rate = <0x1>;
				};
			};

			lcd_bias_enn1_gpio {
				phandle = <0x10>;

				pins_cmd_dat {
					output-high;
					pinmux = <0x1d00>;
					slew-rate = <0x1>;
				};
			};

			lcd_bias_enp0_gpio {
				phandle = <0xf>;

				pins_cmd_dat {
					output-low;
					pinmux = <0x1c00>;
					slew-rate = <0x1>;
				};
			};

			lcd_bias_enp1_gpio {
				phandle = <0xe>;

				pins_cmd_dat {
					output-high;
					pinmux = <0x1c00>;
					slew-rate = <0x1>;
				};
			};

			lcm_dsi_te {
				phandle = <0x14>;

				pins_cmd_dat {
					pinmux = <0x2901>;
				};
			};

			lcm_rst_out0_gpio {
				phandle = <0x13>;

				pins_cmd_dat {
					output-low;
					pinmux = <0x2a00>;
					slew-rate = <0x1>;
				};
			};

			lcm_rst_out1_gpio {
				phandle = <0x12>;

				pins_cmd_dat {
					output-high;
					pinmux = <0x2a00>;
					slew-rate = <0x1>;
				};
			};
		};
	};

	fragment@60 {
		target = <0xffffffff>;

		__overlay__ {
			mediatek,kpd-hw-dl-key0 = <0x11>;
			mediatek,kpd-hw-dl-key1 = <0x0>;
			mediatek,kpd-hw-dl-key2 = <0x8>;
			mediatek,kpd-hw-factory-key = <0x0>;
			mediatek,kpd-hw-init-map = <0x72 0x0 0x0 0x0 0x0 0x0 0x0 0x0 0x0 0x0 0x0 0x0 0x0 0x0 0x0 0x0 0x0 0x0 0x0 0x0 0x0 0x0 0x0 0x0 0x0 0x0 0x0 0x0 0x0 0x0 0x0 0x0 0x0 0x0 0x0 0x0 0x0 0x0 0x0 0x0 0x0 0x0 0x0 0x0 0x0 0x0 0x0 0x0 0x0 0x0 0x0 0x0 0x0 0x0 0x0 0x0 0x0 0x0 0x0 0x0 0x0 0x0 0x0 0x0 0x0 0x0 0x0 0x0 0x0 0x0 0x0 0x0>;
			mediatek,kpd-hw-map-num = <0x48>;
			mediatek,kpd-hw-pwrkey = <0x8>;
			mediatek,kpd-hw-recovery-key = <0x11>;
			mediatek,kpd-hw-rstkey = <0x11>;
			mediatek,kpd-key-debounce = <0x400>;
			mediatek,kpd-pwkey-gpio-din = <0x0>;
			mediatek,kpd-pwrkey-eint-gpio = <0x0>;
			mediatek,kpd-sw-pwrkey = <0x74>;
			mediatek,kpd-sw-rstkey = <0x73>;
			mediatek,kpd-use-extend-type = <0x0>;
			status = "okay";
		};
	};

	fragment@7 {
		target = <0xffffffff>;

		__overlay__ {
			pinctrl-0 = <0xe>;
			pinctrl-1 = <0xf>;
			pinctrl-2 = <0x10>;
			pinctrl-3 = <0x11>;
			pinctrl-4 = <0x12>;
			pinctrl-5 = <0x13>;
			pinctrl-6 = <0x14>;
			pinctrl-names = "lcd_bias_enp1_gpio", "lcd_bias_enp0_gpio", "lcd_bias_enn1_gpio", "lcd_bias_enn0_gpio", "lcm_rst_out1_gpio", "lcm_rst_out0_gpio", "mode_te_te";
			status = "okay";
		};
	};

	fragment@8 {
		target = <0xffffffff>;

		__overlay__ {
			pinctrl-0 = <0x12>;
			pinctrl-1 = <0x13>;
			pinctrl-2 = <0x14>;
			pinctrl-names = "lcm_rst_out1_gpio", "lcm_rst_out0_gpio", "mode_te_te";
			status = "okay";
		};
	};

	fragment@9 {
		target = <0xffffffff>;

		__overlay__ {
			accdet-mic-mode = <0x2>;
			accdet-mic-vol = <0x8>;
			accdet-plugout-debounce = <0x1>;
			eint_use_ext_res = <0x0>;
			headset-four-key-threshold = <0x0 0x3a 0x79 0xc0 0x190>;
			headset-mode-setting = <0x500 0x500 0x1 0x1f0 0x800 0x800 0x20 0x44 0x4 0x1 0x5 0x3 0x3 0x5 0xe>;
			headset-three-key-threshold = <0x0 0x50 0xdc 0x190>;
			headset-three-key-threshold-CDD = <0x0 0x79 0xc0 0x258>;
			status = "okay";
		};
	};
};
